## config/boards/shields/abomination/Kconfig.defconfig
```kconfig
if SHIELD_ABOMINATION_LEFT

config ZMK_KEYBOARD_NAME
    default "Abomination"

config ZMK_SPLIT_BLE_ROLE_CENTRAL
    default y

endif

if SHIELD_ABOMINATION_RIGHT

config ZMK_KEYBOARD_NAME
    default "Abomination (R)"

endif

if SHIELD_ABOMINATION_LEFT || SHIELD_ABOMINATION_RIGHT

config ZMK_SPLIT
    default y

endif
```

## config/boards/shields/abomination/Kconfig.shield
```kconfig
config SHIELD_ABOMINATION_LEFT
    def_bool $(shields_list_contains,abomination_left)

config SHIELD_ABOMINATION_RIGHT
    def_bool $(shields_list_contains,abomination_right)
```
